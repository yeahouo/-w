/**
 * @file oled.c
 * @brief SSD1306 128x64 OLED 驱动实现 — 4 线软件 SPI (CS 接 GND)
 *
 * 引脚 (PINCM 已查 TI SysConfig deviceData MSPM0G350X.json 核实):
 *   SCL (D0) = PA28 = IOMUX_PINCM3
 *   SDA (D1) = PA31 = IOMUX_PINCM6
 *   RES      = PB14 = IOMUX_PINCM31
 *   DC       = PB15 = IOMUX_PINCM32
 *
 * 时序: CLK 空闲低, 上升沿采样 (SSD1306 SPI 模式 0 兼容)
 *       DC=0 发命令, DC=1 发数据; CS 接 GND 永久片选
 */

#include "ti_msp_dl_config.h"
#include "oled.h"

/* ============================================================
 *  SH1106 列偏移开关 — SSD1306 = 0; 若是 1.3" SH1106 改 2
 * ============================================================ */
#define OLED_COL_OFFSET   (0)

/* ============================================================
 *  引脚定义
 * ============================================================ */
#define OLED_SCL_PORT   GPIOA
#define OLED_SCL_PIN    DL_GPIO_PIN_28
#define OLED_SCL_PINCM  IOMUX_PINCM3

#define OLED_SDA_PORT   GPIOA
#define OLED_SDA_PIN    DL_GPIO_PIN_31
#define OLED_SDA_PINCM  IOMUX_PINCM6

#define OLED_RES_PORT   GPIOB
#define OLED_RES_PIN    DL_GPIO_PIN_14
#define OLED_RES_PINCM  IOMUX_PINCM31

#define OLED_DC_PORT    GPIOB
#define OLED_DC_PIN     DL_GPIO_PIN_15
#define OLED_DC_PINCM   IOMUX_PINCM32

/* ============================================================
 *  ms 级延时 — 复用 main.c 的 SysTick 毫秒时钟
 *  必须在 SysTick_Config() 之后调用
 * ============================================================ */
extern volatile uint32_t g_system_ms;

static void oled_delay_ms(uint32_t ms)
{
    uint32_t start = g_system_ms;
    while (g_system_ms - start < ms) { __NOP(); }
}

/* SPI 位时序延时 (~几 us @ 80MHz, SSD1306 SPI 时钟上限 4MHz, 软件远低于此) */
static inline void oled_spi_delay(void)
{
    for (volatile int i = 0; i < 10; ++i) { __NOP(); }
}

/* ============================================================
 *  6x8 ASCII 字模 (0x20 .. 0x7E, 共 95 字符)
 *  每字符 6 字节: 5 列点阵 + 1 列空白间隔; bit0 = 顶行
 *  数据为公开领域标准 5x7 字体
 * ============================================================ */
static const uint8_t font6x8[95][6] = {
    {0x00,0x00,0x00,0x00,0x00,0x00}, /* ' ' */
    {0x00,0x00,0x5F,0x00,0x00,0x00}, /* '!' */
    {0x00,0x07,0x00,0x07,0x00,0x00}, /* '"' */
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    {0x02,0x01,0x02,0x04,0x02,0x00}, /* '~' */
};

/* ============================================================
 *  显存副本 (页寻址: s_gram[page][col])
 * ============================================================ */
static uint8_t s_gram[OLED_PAGES][OLED_WIDTH_PX];

/* ============================================================
 *  软件 SPI — MSB first, 上升沿采样
 * ============================================================ */
static void oled_spi_write(uint8_t b)
{
    for (int8_t i = 7; i >= 0; i--) {
        DL_GPIO_clearPins(OLED_SCL_PORT, OLED_SCL_PIN);   /* CLK 拉低 */
        if (b & (0x01 << i)) DL_GPIO_setPins  (OLED_SDA_PORT, OLED_SDA_PIN);
        else                 DL_GPIO_clearPins(OLED_SDA_PORT, OLED_SDA_PIN);
        oled_spi_delay();
        DL_GPIO_setPins(OLED_SCL_PORT, OLED_SCL_PIN);     /* 上升沿 → OLED 采样 */
        oled_spi_delay();
    }
    DL_GPIO_clearPins(OLED_SCL_PORT, OLED_SCL_PIN);       /* 回到空闲低 */
}

static void oled_write_cmd(uint8_t c)
{
    DL_GPIO_clearPins(OLED_DC_PORT, OLED_DC_PIN);   /* DC=0 命令 */
    oled_spi_write(c);
}

static void oled_write_data(uint8_t d)
{
    DL_GPIO_setPins(OLED_DC_PORT, OLED_DC_PIN);     /* DC=1 数据 */
    oled_spi_write(d);
}

/* ============================================================
 *  SSD1306 128x64 标准初始化序列
 *  (单字节命令与带参数命令都按 DC=0 连续发, 参数字节也走 cmd 通道)
 * ============================================================ */
static const uint8_t s_init_seq[] = {
    0xAE,             /* display off */
    0xD5, 0x80,       /* display clock divide / oscillator */
    0xA8, 0x3F,       /* multiplex ratio = 64 */
    0xD3, 0x00,       /* display offset = 0 */
    0x40,             /* start line = 0 */
    0x8D, 0x14,       /* charge pump enable (必须开, 否则屏不亮) */
    0x20, 0x00,       /* addressing mode = horizontal */
    0xA1,             /* segment remap: 列 127 → SEG0 */
    0xC8,             /* COM scan direction: COM[N-1] → COM0 */
    0xDA, 0x12,       /* COM pins hardware config (128x64) */
    0x81, 0xCF,       /* contrast */
    0xD9, 0xF1,       /* pre-charge period */
    0xDB, 0x40,       /* VCOMH deselect level */
    0xA4,             /* display follow GDDRAM (不强制全亮) */
    0xA6,             /* normal (非反色) */
    0xAF,             /* display ON */
};

/* ============================================================
 *  公开 API
 * ============================================================ */

void OLED_Init(void)
{
    /* RES 复位序列: 低 ≥10ms → 高 → 等 100ms */
    DL_GPIO_clearPins(OLED_RES_PORT, OLED_RES_PIN);
    oled_delay_ms(15);
    DL_GPIO_setPins(OLED_RES_PORT, OLED_RES_PIN);
    oled_delay_ms(100);

    /* 发初始化命令 */
    for (uint16_t i = 0; i < sizeof(s_init_seq); i++) {
        oled_write_cmd(s_init_seq[i]);
    }

    OLED_Clear();
}

void OLED_Clear(void)
{
    for (uint8_t p = 0; p < OLED_PAGES; p++) {
        for (uint8_t c = 0; c < OLED_WIDTH_PX; c++) {
            s_gram[p][c] = 0x00;
        }
    }
    OLED_Refresh();
}

void OLED_Refresh(void)
{
    uint8_t col_lo = (uint8_t)(OLED_COL_OFFSET & 0x0F);
    uint8_t col_hi = (uint8_t)((OLED_COL_OFFSET >> 4) & 0x0F);

    for (uint8_t p = 0; p < OLED_PAGES; p++) {
        oled_write_cmd(0xB0 | p);            /* 设页地址 0..7 */
        oled_write_cmd(0x00 | col_lo);       /* 列地址低 4 位 */
        oled_write_cmd(0x10 | col_hi);       /* 列地址高 4 位 */
        for (uint8_t c = 0; c < OLED_WIDTH_PX; c++) {
            oled_write_data(s_gram[p][c]);
        }
    }
}

void OLED_SetPixel(uint8_t x, uint8_t y, uint8_t on)
{
    if (x >= OLED_WIDTH_PX || y >= OLED_HEIGHT_PX) return;
    uint8_t page = (uint8_t)(y >> 3);
    uint8_t bit  = (uint8_t)(0x01 << (y & 0x07));
    if (on) s_gram[page][x] |= bit;
    else    s_gram[page][x] &= (uint8_t)~bit;
}

void OLED_DrawChar(uint8_t x, uint8_t y, char ch)
{
    uint8_t uc = (uint8_t)ch;
    if (uc < 0x20 || uc > 0x7E) uc = (uint8_t)' ';
    if (x > 21 || y >= OLED_PAGES) return;

    const uint8_t *g = font6x8[uc - 0x20];
    uint8_t col = (uint8_t)(x * 6);
    for (uint8_t i = 0; i < 6; i++) {
        if (col + i < OLED_WIDTH_PX) s_gram[y][col + i] = g[i];
    }
}

void OLED_DrawString(uint8_t x, uint8_t y, const char *s)
{
    while (*s != '\0' && x <= 21) {
        OLED_DrawChar(x, y, *s);
        x++;
        s++;
    }
}
